/**
 *
 *	@file		key.cpp
 *
 *	@brief		キー入力処理
 *
 *	@author		株式会社エムスクエア・ラボ　山形
 *
 *	@date		create : 2024/01/16
 *
 */
#include <Arduino.h>
#include "timer.hpp"
#include "key.hpp"
/*==========================================================================================
	外部関数定義
==========================================================================================*/


/*==========================================================================================
	内部定数定義
==========================================================================================*/

/*==========================================================================================
	内部関数定義
==========================================================================================*/
/*==========================================================================================
	外部変数定義
==========================================================================================*/
/*==========================================================================================
	内部変数定義
==========================================================================================*/
/**
 *	@var		ssPins
 *	@brief		RFIDチャンネル
 */

/**
 *	@var		mfrc522
 *	@brief		各チャンネルインスタンス
 */


/*==========================================================================================
	関数
==========================================================================================*/

/**
 *	@brief		インタラクタ
 *	@param		t:設定時間
 *	@retval		なし
 */
KeyInput::KeyInput(int pin, unsigned long t){
	keyPin = pin;
	pinMode(keyPin, INPUT);
	timer = new IntervalTimer(t);
}

/**
 *	@brief		デスイントラクタ
 *	@param		なし
 *	@retval		なし
 */
KeyInput::~KeyInput(void){
	delete timer;
}

/**
 *	@brief		時間経過確認
 *	@param		なし
 *	@retval		0：時間未経過　1：時間経過
 */
int KeyInput::isKey(void){
	if(!digitalRead(keyPin)){
		if(timer->isWait()){
			if(!toggle){
				toggle = 1;
				return 1;
			}
		}
	}else{
		toggle = 0;
		timer->init();
	}
	return 0;
}

/**
 *	@brief		時間設定
 *	@param		t:設定時間
 *	@retval		なし
 */
void KeyInput::setTime(unsigned long t){
	timer->setTime(t);
}

/**
 *	@brief		初期化
 *	@param		t:設定時間
 *	@retval		なし
 */
void KeyInput::init(void){
	timer->init();
}